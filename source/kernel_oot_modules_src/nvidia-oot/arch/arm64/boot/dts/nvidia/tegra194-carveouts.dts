// SPDX-License-Identifier: GPL-2.0

/dts-v1/;
/plugin/;

/ {
	fragment@0 {
		target-path = "/";
		__overlay__ {

			reserved-memory {
				#address-cells = <2>;
				#size-cells = <2>;
				ranges;

				vpr: vpr-carveout {
					compatible = "nvidia,vpr-carveout";
					status = "okay";
				};
			};

			tegra-carveouts {
				compatible = "nvidia,carveouts-t19x";
				memory-region = <&vpr>;
				status = "okay";
			};
		};
	};
};
